## drivers/display/Kconfig.infineon_gfxss
```kconfig
# Copyright The Zephyr Project Contributors
# SPDX-License-Identifier: Apache-2.0

config DISPLAY_INFINEON_GFXSS
	bool "Infineon GFXSS display controller driver"
	default y
	depends on DT_HAS_INFINEON_GFXSS_DC_ENABLED
	select USE_INFINEON_GFXSS
	select CACHE_MANAGEMENT if CPU_HAS_DCACHE
	help
	  Enable driver for the display controller of the Infineon graphics subsystem
	  (GFXSS), driving a MIPI DSI panel in video mode.

if DISPLAY_INFINEON_GFXSS

config HEAP_MEM_POOL_ADD_SIZE_DISPLAY_INFINEON_GFXSS
	int
	default 8192
	help
	  System heap reserved for the state the GFXSS HAL allocates with k_malloc().

endif # DISPLAY_INFINEON_GFXSS
```

## drivers/display/Kconfig.rpi_dsi_panel_mcu
```kconfig
# Copyright The Zephyr Project Contributors
# SPDX-License-Identifier: Apache-2.0

config RPI_DSI_PANEL_MCU
	bool "Raspberry Pi DSI panel control MCU driver"
	default y
	depends on DT_HAS_RASPBERRYPI_DSI_PANEL_MCU_ENABLED
	select I2C
	select MIPI_DSI
	help
	  Enable driver for the I2C controlled MCU on Raspberry Pi touchscreen compatible
	  DSI panels, such as the Waveshare 4.3 inch DSI LCD.
```

## drivers/mipi_dsi/Kconfig.infineon_gfxss
```kconfig
# Copyright The Zephyr Project Contributors
# SPDX-License-Identifier: Apache-2.0

config MIPI_DSI_INFINEON_GFXSS
	bool "Infineon GFXSS MIPI DSI host driver"
	default y
	depends on DT_HAS_INFINEON_GFXSS_MIPI_DSI_ENABLED
	depends on DISPLAY_INFINEON_GFXSS
	help
	  Enable driver for the MIPI DSI host of the Infineon graphics subsystem (GFXSS).
```

## dts/bindings/display/infineon,gfxss-dc.yaml
```yaml
# Copyright The Zephyr Project Contributors
# SPDX-License-Identifier: Apache-2.0

title: Infineon GFXSS display controller

description: |
  Display controller of the Infineon graphics subsystem (GFXSS) found on PSOC Edge
  devices. It scans out a framebuffer through its DPI output into the MIPI DSI host
  of the same subsystem, which is described by the mipi-dsi child node.

  The controller fetches lines in multiples of 128 bytes, so the active width sent
  to the panel is the width property rounded up to a 128-byte stride. The display
  API exposes the width property.

  Example:

    &gfxss {
        status = "okay";
        width = <800>;
        height = <480>;
        pixel-format = <PANEL_PIXEL_FORMAT_RGB_565>;
        memory-region = <&gfx_mem>;

        display-timings {
            compatible = "zephyr,panel-timing";
            clock-frequency = <33768000>;
            hsync-len = <10>;
            hfront-porch = <210>;
            hback-porch = <20>;
            vsync-len = <5>;
            vfront-porch = <20>;
            vback-porch = <20>;
        };
    };

compatible: "infineon,gfxss-dc"

include: lcd-controller.yaml

properties:
  reg:
    required: true

  interrupts:
    required: true

  memory-region:
    type: phandle
    required: true
    description: |
      Memory region holding the framebuffer. It must be reachable by the display
      controller bus master and large enough for one frame at the padded stride.
```

## dts/bindings/display/raspberrypi,dsi-panel-mcu.yaml
```yaml
# Copyright The Zephyr Project Contributors
# SPDX-License-Identifier: Apache-2.0

title: Raspberry Pi DSI panel control MCU

description: |
  Microcontroller on the controller board of the Raspberry Pi 7 inch touchscreen,
  and of panels compatible with it such as the Waveshare 4.3 inch DSI LCD. It
  powers the DSI-to-DPI bridge and the panel and drives the backlight PWM over
  I2C. The bridge itself needs no DSI commands, so the driver only checks that the
  DSI host link matches the panel.

compatible: "raspberrypi,dsi-panel-mcu"

include: i2c-device.yaml

properties:
  data-lanes:
    type: array
    required: true
    description:
      Number of data lanes.

  pixel-format:
    type: int
    required: true
    description:
      Pixel format. Available formats in dt-bindings/mipi_dsi/mipi_dsi.h.

  mipi-dsi:
    type: phandle
    required: true
    description: |
      MIPI DSI host the panel is connected to.

  brightness:
    type: int
    default: 255
    description: |
      Backlight PWM duty cycle applied at initialization, 0 to 255.
```

## dts/bindings/mipi-dsi/infineon,gfxss-mipi-dsi.yaml
```yaml
# Copyright The Zephyr Project Contributors
# SPDX-License-Identifier: Apache-2.0

title: Infineon GFXSS MIPI DSI host

description: |
  MIPI DSI host of the Infineon graphics subsystem (GFXSS). The node is a child of
  the infineon,gfxss-dc display controller, which brings up the D-PHY together with
  the display controller before any panel attaches. The lane count and pixel format
  are therefore needed here as well as on the panel node, and the two have to agree.
  Only video mode is supported.

compatible: "infineon,gfxss-mipi-dsi"

include: mipi-dsi-host.yaml

properties:
  phy-clock:
    required: true
    description: |
      Bit rate of each data lane, in bits per second.

  data-lanes:
    type: int
    required: true
    enum: [1, 2]
    description: |
      Number of MIPI DSI data lanes.

  pixel-format:
    type: int
    required: true
    enum: [0]
    description: |
      Pixel format sent over the link. Available formats in
      dt-bindings/mipi_dsi/mipi_dsi.h. Only MIPI_DSI_PIXFMT_RGB888 is supported.
```
